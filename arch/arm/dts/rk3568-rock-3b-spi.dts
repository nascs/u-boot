// SPDX-License-Identifier: (GPL-2.0+ OR MIT)
/*
 * Copyright (c) 2024 Rockchip Electronics Co., Ltd.
 * Copyright (c) 2024 Radxa Computer (Shenzhen) Co., Ltd.
 */

/dts-v1/;
#include "rk3568-rock-3b.dts"

&sdhci {
	status = "disabled";
};

&sfc {
	status = "okay";
};

&spi_flash {
	status = "okay";
};
